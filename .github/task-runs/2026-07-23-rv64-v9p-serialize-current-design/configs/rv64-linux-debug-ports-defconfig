## nemu/Kconfig
```kconfig
mainmenu "NEMU Configuration Menu"

# 这里是 NEMU 唯一的 Kconfig 入口，只描述会改变构建产物、guest ISA、平台
# ABI 或用户可观察能力的选择。只有一个合法取值和纯实现内部条件集中在
# include/nemu-config.h，避免出现“菜单可配置、运行时却没有实际分支”的假接口。

choice
  prompt "Base ISA"
  default ISA_riscv
config ISA_x86
  bool "x86"
config ISA_mips32
  bool "mips32"
config ISA_riscv
  bool "riscv"
config ISA_loongarch32r
  bool "loongarch32r"
endchoice

config ISA
  string
  default "x86" if ISA_x86
  default "mips32" if ISA_mips32
  default "riscv32" if ISA_riscv && !RV64
  default "riscv64" if ISA_riscv &&  RV64
  default "loongarch32r" if ISA_loongarch32r
  default "none"

config ISA64
  depends on ISA_riscv && RV64
  bool
  default y


if ISA_riscv
config RV64
  bool "64-bit RISC-V architecture"
  default n

menu "RISC-V ISA Extensions"

config RVE
  depends on !RV64
  bool "Use E extension"
  default n

config RISCV_EXT_M
  bool "Enable M extension (integer multiply/divide)"
  default y
  help
    控制 NEMU 是否接受 RISC-V 乘除法指令编码。关闭后，mul/div/rem
    等编码按 illegal instruction trap 处理；AM guest 编译参数同步移除 m。

config RISCV_EXT_A
  bool "Enable A extension (atomic memory operations)"
  default n
  help
    控制 NEMU 是否接受 LR/SC/AMO 指令。RV64 Linux/OpenSBI 常用 AMO
    实现自旋锁和原子变量，因此 Linux 平台配置需要显式打开。

config RISCV_EXT_F
  depends on !TARGET_AM
  bool "Enable F extension (single-precision floating point)"
  default n
  help
    控制 NEMU 是否接受浮点寄存器相关基础指令。Linux/Ubuntu 的
    rv64gc 用户态启动会通过内核 fstate 路径使用 F/D 寄存器搬运。
    Abstract-Machine target 是 NEMU 自身的宿主构建目标，没有可用的
    target-ABI SoftFloat 库；该目标保持整数解释器，不能选择 F/D。

config RISCV_EXT_D
  depends on RISCV_EXT_F
  bool "Enable D extension (double-precision floating point)"
  default n
  help
    控制 NEMU 是否接受双精度浮点寄存器搬运指令。当前 Linux bring-up
    至少需要 fld/fsd 以及对应压缩指令恢复用户态浮点上下文。

config RISCV_EXT_B
  bool "Enable B extension (Zba/Zbb/Zbc/Zbs bit manipulation)"
  default n
  help
    控制 NEMU 是否接受当前 GCC 已拆分命名的 bitmanip 子扩展：
    Zba/Zbb/Zbc/Zbs。AM guest 编译参数会同步追加
    _zba_zbb_zbc_zbs，而不是使用 GCC 不接受默认版本的裸 b。

config RISCV_EXT_C
  bool "Enable C extension (compressed instructions)"
  default n
  help
    控制 NEMU 是否按 16/32 位可变长度取指并执行压缩整数指令；
    AM guest 编译参数同步追加 c。

config SOC_SIM
  depends on ISA_riscv && !RV64 && !TARGET_AM
  bool "Use the ysyxSoC platform profile"
  default n
  help
    选择 NEMU 内镜像的 ysyxSoC 物理地址图和设备组成。SOC UART、
    SPI、GPIO、PS/2、MROM、VGA、flash 和 SDRAM 由该平台直接拥有，
    不再实例化同地址的 generic IOMap 设备。该平台核心不依赖
    CONFIG_DEVICE；CONFIG_DEVICE 在此模式下只用于显式选择不重叠的
    NEMU service extension。外部 ysyxSoC 不含 CLINT/PLIC，UART 中断也未
    接入 CPU，因此该 profile 不暴露这些 generic RISC-V 控制器；内部
    instruction-time counter 只服务 time/timeh CSR。NEMU 主 PMEM 必须
    精确承载 0x80000000
    起始的 4 MiB PSRAM，而不是额外添加一块泛化内存。关闭时使用
    generic NEMU 平台。该 profile 用于 native simulator 或 DiffTest
    reference；NEMU 自身作为 Abstract-Machine 应用时不提供这套宿主模型。

config RISCV_CLINT_HOST_TIME
  depends on RV64
  bool "Use host monotonic time for RV64 CLINT mtime"
  default n
  help
    让 RV64 CLINT mtime/CSR time 以宿主 monotonic time 为基准前进，WFI
    只做短 host sleep。Linux/Ubuntu 可获得真实时间语义；AM/指令级实验
    可继续关闭本选项，保留 instruction-time 语义。

endmenu
endif

choice
  prompt "Build target"
  default TARGET_NATIVE_ELF
config TARGET_NATIVE_ELF
  bool "Executable on Linux Native"
config TARGET_SHARE
  bool "Shared object (used as REF for differential testing)"
config TARGET_AM
  bool "Application on Abstract-Machine (DON'T CHOOSE)"
endchoice

menu "Build Options"
choice
  prompt "Compiler"
  default CC_GCC
config CC_GCC
  bool "gcc"
config CC_GPP
  bool "g++"
config CC_CLANG
  depends on !TARGET_AM
  bool "clang"
endchoice

config CC
  string
  default "gcc" if CC_GCC
  default "g++" if CC_GPP
  default "clang" if CC_CLANG
  default "none"

choice
  prompt "Optimization Level"
  default CC_O2
config CC_O0
  bool "O0"
config CC_O1
  bool "O1"
config CC_O2
  bool "O2"
config CC_O3
  bool "O3"
endchoice

config CC_OPT
  string
  default "-O0" if CC_O0
  default "-O1" if CC_O1
  default "-O2" if CC_O2
  default "-O3" if CC_O3
  default "none"

config CC_LTO
  depends on !TARGET_AM
  bool "Enable link-time optimization"
  default n

config PERFORMANCE
  depends on TARGET_NATIVE_ELF
  bool "Performance mode: disable debug traces and counters"
  default n
  help
    一键性能模式。开启后，trace、difftest、watchpoint、透明 BPU 统计模型、
    运行时检查、ASAN 以及调试诊断日志都会被配置层关闭，适合 Linux/Ubuntu
    长跑时减少热路径开销和控制台噪声。

config CC_DEBUG
  bool "Enable debug information"
  default n

config CC_ASAN
  depends on !PERFORMANCE
  bool "Enable address sanitizer"
  default n
endmenu

menu "CPU Performance Models"
  depends on TARGET_NATIVE_ELF && ISA_riscv

config INTERPRETER_BASIC_BLOCK
  depends on PERFORMANCE
  bool "Enable conservative interpreter basic-block batching"
  default y
  help
    在 Ubuntu/Linux performance 配置下，把普通连续指令按小块执行；
    中断查询和设备轮询只在块边界发生。遇到控制流、SYSTEM、store/AMO、
    fence 或压缩控制/存储指令时立即结束当前块。

config INTERPRETER_TB_MAX_INST
  depends on INTERPRETER_BASIC_BLOCK
  int "Maximum instructions in one interpreter basic block"
  range 1 256
  default 32 if PERFORMANCE
  default 16
  help
    单个解释器 basic block 最多连续退休的 guest 指令数。它只是保守上限，
    不是 TB chaining 或 JIT。

config INTERPRETER_WIDE_IFETCH
  depends on INTERPRETER_BASIC_BLOCK && RISCV_EXT_C
  bool "Enable one-translation wide ifetch for RVC"
  default y
  help
    同页 PMEM host pointer 命中时一次读取 4 字节并判断 16/32 位指令；
    跨页、MMIO 或 fault 场景仍回退精确路径。

config INTERPRETER_IFETCH_PAGE_CACHE
  depends on INTERPRETER_WIDE_IFETCH && RV64 && !CACHE && !MTRACE
  bool "Cache current ifetch host page"
  default y if PERFORMANCE
  default n
  help
    为 wide ifetch 缓存当前虚拟页对应的 PMEM host page；tag 包含虚拟页、
    satp 和特权级，sfence.vma、fence.i、TLB flush 和相关写入会使其失效。

config INTERPRETER_INTR_FAST_FLAG
  depends on INTERPRETER_BASIC_BLOCK && RV64
  bool "Enable fast interrupt pending guard at TB boundary"
  default y
  help
    在进入完整 isa_query_intr() 前做保守 pending/enable/global 判断；
    不改变 CLINT、PLIC 或 CSR 语义。

config BPU
  depends on TARGET_NATIVE_ELF && ISA_riscv && !PERFORMANCE
  bool "Enable branch prediction model"
  default y
  help
    启用透明的 BPU 统计模型；它只比较预测结果，不改变真实执行 PC。

config BPU_BTB_ENTRIES
  depends on BPU
  int "BPU BTB entries"
  range 1 4096
  default 128

config BPU_BHT_ENTRIES
  depends on BPU
  int "BPU BHT entries"
  range 1 8192
  default 256

config BPU_RAS_ENTRIES
  depends on BPU
  int "BPU RAS entries"
  range 1 128
  default 16

config BPU_COUNTER_BITS
  depends on BPU
  int "BPU saturating counter bits"
  range 1 8
  default 2

config BPU_COUNTER_INIT
  depends on BPU
  int "BPU initial counter value"
  range 0 255
  default 1
  help
    2-bit 计数器默认值 1 表示 weakly not-taken；该值必须能由计数器位宽表示。

config BPU_GHR_BITS
  depends on BPU
  int "BPU global history bits"
  range 0 16
  default 0
  help
    0 表示 BHT 只按 PC 索引；大于 0 时用 PC 与全局分支历史异或索引。

endmenu

menu "Testing and Debugging"

config WATCHPOINT
  # 监视点实现依赖 src/monitor/sdb；AM 目标会把该目录排除出构建，
  # 因此这里直接禁止在 AM 下开启，避免配置和源码集合失配。
  depends on !TARGET_AM && !PERFORMANCE
  bool "Enable watchpoint feature"
  default y

config BATCH_MODE
  # 批处理模式同样依赖 src/monitor/sdb；AM 目标没有 monitor 交互循环，
  # 因此这里不暴露该配置，避免出现“配了但没有生效点”的假接口。
  depends on !TARGET_AM
  bool "Run NEMU in batch mode by default"
  default n
  help
    启动时默认跳过 SDB 的 readline 交互循环，直接执行 continue。
    命令行 -b/--batch 仍然保留，用于按次显式开启批处理模式。

config TRACE
  depends on !PERFORMANCE
  bool "Enable tracer"
  default y

config STATISTIC
  depends on !TARGET_AM && !PERFORMANCE
  bool "Print execution statistics"
  default y
  help
    结束时打印 host time、guest instruction、simulation frequency，并串接
    cache/BPU 等统计输出。性能模式会关闭该项，但仍保留必要的 cache flush。

config RISCV_DEBUG_LOG
  depends on ISA_riscv && TARGET_NATIVE_ELF && !PERFORMANCE
  bool "Enable RISC-V boot/MMU/trap debug logs"
  default y
  help
    打印少量 CSR、Sv39 page fault 和 trap 诊断日志。该日志对 bring-up 很有用，
    但 Ubuntu 长跑时会污染 console 并增加 I/O 开销，性能模式会关闭它。

config RISCV_FAULT_DEBUG_BUDGET
  depends on RISCV_DEBUG_LOG
  int "RISC-V MMU/trap debug log budget"
  default 16
  help
    限制 Sv39 fault 与 trap 诊断日志条数；调大后可观察 execve/page-fault
    是否持续推进，但只应在 debug defconfig 下使用。

config RISCV_PROGRESS_DEBUG_LOG
  depends on RISCV_DEBUG_LOG
  bool "Enable low-rate RISC-V execution progress logs"
  default n
  help
    按固定 guest 指令间隔打印当前 PC、特权级和关键 CSR，用于判断 Linux
    长跑时是在推进、内核态自旋还是用户态自旋。默认关闭，性能模式也会
    通过 RISCV_DEBUG_LOG 依赖关闭它。

config RISCV_PROGRESS_DEBUG_INTERVAL
  depends on RISCV_PROGRESS_DEBUG_LOG
  int "RISC-V progress log interval in guest instructions"
  default 100000000
  help
    进度心跳的 guest 指令间隔。调试 Ubuntu/systemd 早期启动时建议保持在
    1e8 量级，既能观察卡点，又不会刷屏拖慢解释器。

config RISCV_IRQ_DEBUG_LOG
  depends on ISA_riscv && TARGET_NATIVE_ELF && TRACE && !PERFORMANCE && !SOC_SIM
  bool "Enable RISC-V PLIC/IRQ debug logs"
  default n
  help
    在 TRACE_START/TRACE_END 窗口内记录少量 PLIC claim/complete 事件，
    用于区分 UART、virtio 等外部中断源。默认关闭，避免长跑时刷屏。

config RISCV_SYSCALL_DEBUG_LOG
  depends on ISA_riscv && RV64 && TARGET_NATIVE_ELF && !PERFORMANCE
  bool "Enable RV64 Linux syscall debug logs"
  default n
  help
    记录 U-mode ecall 的 syscall 号、参数以及返回值，用于定位 Linux
    PID1/rootfs bring-up 卡在具体哪个系统调用。该 trace 默认关闭，性能模式
    也会关闭它，避免长跑时在热路径写日志。

config RISCV_SYSCALL_DEBUG_BUDGET
  depends on RISCV_SYSCALL_DEBUG_LOG
  int "RV64 Linux syscall debug log budget"
  default 256
  help
    限制 syscall trace 的入口条数；每个入口最多再配一个返回日志，避免
    Ubuntu 用户态长跑时持续刷屏。

config TRACE_START
  depends on TRACE
  int "When tracing is enabled (unit: number of instructions)"
  default 0

config TRACE_END
  depends on TRACE
  # 0 表示不设置结束点，便于只打开 trace 开关时默认持续记录。
  int "When tracing is disabled (0 = unlimited, unit: number of instructions)"
  default 0

config MTRACE
  depends on TRACE && TARGET_NATIVE_ELF
  bool "Enable memory access trace"
  default y

config ITRACE
  depends on TRACE && TARGET_NATIVE_ELF
  bool "Enable instruction tracer"
  default y

config DTRACE
  depends on TRACE && TARGET_NATIVE_ELF
  bool "Enable device trace (MMIO)"
  default y

config ETRACE
  # ETRACE 直接记录 RISC-V trap 入口和 mret 返回，依赖 native 日志文件承载输出。
  depends on TRACE && TARGET_NATIVE_ELF && ISA_riscv
  bool "Enable exception trace (etrace)"
  default y
  help
    记录异常/中断进入 trap 以及 mret 返回时的关键 CSR 和 PC，便于调试 CTE
    的 ecall -> mtvec -> mret 往返链路。

config FTRACE
  depends on TRACE && TARGET_NATIVE_ELF
  bool "Enable function call trace (ftrace)"
  default y

config DIFFTEST
  depends on TARGET_NATIVE_ELF && !PERFORMANCE
  bool "Enable differential testing"
  default n
  help
    Enable differential testing with a reference design.
    Note that this will significantly reduce the performance of NEMU.

choice
  prompt "Reference design"
  default DIFFTEST_REF_SPIKE if ISA_riscv
  default DIFFTEST_REF_KVM if ISA_x86
  default DIFFTEST_REF_QEMU
  depends on DIFFTEST
config DIFFTEST_REF_QEMU
  bool "QEMU, communicate with socket"
if ISA_riscv
config DIFFTEST_REF_SPIKE
  bool "Spike"
endif
if ISA_x86
config DIFFTEST_REF_KVM
  bool "KVM"
endif
endchoice

config DIFFTEST_REF_PATH
  string
  default "tools/qemu-diff" if DIFFTEST_REF_QEMU
  default "tools/kvm-diff" if DIFFTEST_REF_KVM
  default "tools/spike-diff" if DIFFTEST_REF_SPIKE
  default "none"

config DIFFTEST_REF_NAME
  string
  default "qemu" if DIFFTEST_REF_QEMU
  default "kvm" if DIFFTEST_REF_KVM
  default "spike" if DIFFTEST_REF_SPIKE
  default "none"
endmenu

menu "Memory Configuration"

config MBASE
  hex "Memory base address" if !SOC_SIM
  default 0x0 if ISA_x86
  default 0x80000000 if SOC_SIM
  default 0x80000000
  help
    generic profile 的主内存基址可配置；SOC_SIM 下该值固定为
    ysyxSoC PSRAM 基址 0x80000000。generic RISC-V 的最终 PMEM 区间
    不得与固定 CLINT/PLIC aperture 重叠；启动时会验证该机器地图。

config MSIZE
  hex "Memory size" if !SOC_SIM
  default 0x00400000 if SOC_SIM
  default 0x8000000
  help
    generic profile 的主内存容量可配置；SOC_SIM 下该值固定为
    ysyxSoC PSRAM 容量 4 MiB。容量必须非零、不得导致物理地址回绕，
    并与 MBASE 一起满足所选平台的固定地址所有权约束。

config PC_RESET_OFFSET
  hex "Offset of reset vector from the base of memory" if !SOC_SIM
  default 0x100000 if ISA_x86
  default 0
  help
    generic profile 的复位向量相对主内存基址计算；SOC_SIM 的复位向量
    固定为 ysyxSoC MROM 0x20000000，本选项在该 profile 下不参与语义。

choice
  prompt "Physical memory definition"
  default PMEM_GARRAY
config PMEM_MALLOC
  bool "Using malloc()"
config PMEM_GARRAY
  depends on !TARGET_AM
  bool "Using global array"
endchoice

config MEM_RANDOM
  depends on !DIFFTEST && !TARGET_AM && !PERFORMANCE
  bool "Initialize the memory with random values"
  default y
  help
    This may help to find undefined behaviors.

config CACHE
  depends on TARGET_NATIVE_ELF
  bool "Enable ICache and DCache model"
  default y
  help
    在 vaddr 层启用透明 ICache/DCache 模型；MMIO 仍直通 paddr 层。

config CACHE_STATISTIC
  depends on CACHE && !PERFORMANCE
  bool "Print cache access counters"
  default y
  help
    控制退出时是否打印 cache 统计；关闭后仍执行必要的 DCache flush。

config ICACHE_SIZE
  depends on CACHE
  int "ICache size in bytes"
  default 4096

config DCACHE_SIZE
  depends on CACHE
  int "DCache size in bytes"
  default 4096

config CACHE_LINE_SIZE
  depends on CACHE
  int "Cache line size in bytes"
  default 64

endmenu

menuconfig DEVICE
  depends on !TARGET_SHARE
  bool "Devices"
  default n
  help
    Provide host-backed devices for NEMU.  In the ysyxSoC platform profile,
    only explicitly selected, non-overlapping service extensions are exposed;
    the SoC-owned devices are initialized by the platform itself.

if DEVICE

config DEVICE_MAP_LEGACY
  depends on !SOC_SIM
  bool "Use legacy AM device map (0xa0000000 family)"
  default n
  help
    generic profile 默认使用 platform/generic-map.h 中的现代 IOMap 地址图；
    仅封存的 RV32 旧目标需要切回 legacy AM 图。SOC_SIM 使用独立的
    platform/ysyxsoc-map.h，因此不会出现此选项。

menuconfig HAS_SERIAL
  depends on !SOC_SIM
  bool "Enable serial"
  default y

if HAS_SERIAL
config SERIAL_PORT
  depends on ISA_x86
  hex "Port address of the serial controller"
  default 0x3f8

config SERIAL_INPUT_FIFO
  depends on !TARGET_AM
  bool "Enable input FIFO with /tmp/nemu.serial"
  default n

config SERIAL_INPUT_STDIN
  depends on !TARGET_AM
  bool "Attach host stdin to serial RX"
  default y if BATCH_MODE
  default n

config SERIAL_INPUT_HOST_POLL_INTERVAL
  depends on SERIAL_INPUT_STDIN || SERIAL_INPUT_FIFO
  int "Host device ticks between serial input polls"
  range 1 64
  default 4 if PERFORMANCE
  default 1
  help
    guest 主动读取 UART 时仍立即轮询宿主输入；该值只控制空闲 host tick。
endif

menuconfig HAS_TIMER
  depends on !SOC_SIM
  bool "Enable timer"
  default n if ISA64 && !TARGET_AM
  default y

if HAS_TIMER
config RTC_PORT
  depends on ISA_x86
  hex "Port address of the timer"
  default 0x48
endif

menuconfig HAS_KEYBOARD
  depends on !SOC_SIM
  bool "Enable keyboard"
  default n if ISA64 && !TARGET_AM
  default y

if HAS_KEYBOARD
config I8042_DATA_PORT
  depends on ISA_x86
  hex "Port address of the keyboard controller"
  default 0x60
endif

menuconfig HAS_VGA
  depends on !SOC_SIM
  bool "Enable VGA"
  default n if ISA64 && !TARGET_AM
  default y

if HAS_VGA
config VGA_CTL_PORT
  depends on ISA_x86
  hex "Port address of the VGA controller"
  default 0x100

config VGA_SHOW_SCREEN
  bool "Enable SDL SCREEN"
  default y

choice
  prompt "Screen Size"
  default VGA_SIZE_400x300
config VGA_SIZE_400x300
  bool "400 x 300"
config VGA_SIZE_800x600
  bool "800 x 600"
endchoice
endif

if !TARGET_AM
menuconfig HAS_AUDIO
  depends on !SOC_SIM
  bool "Enable audio"
  default n if ISA64
  default y

if HAS_AUDIO
config SB_SIZE
  hex "Size of the audio stream buffer"
  default 0x10000

config AUDIO_CTL_PORT
  depends on ISA_x86
  hex "Port address of the audio controller"
  default 0x200
endif

menuconfig HAS_DISK
  depends on !SOC_SIM
  bool "Enable disk"
  default y

if HAS_DISK
config DISK_CTL_PORT
  depends on ISA_x86
  hex "Port address of the disk controller"
  default 0x300

config DISK_IMG_PATH
  string "The path of disk image"
  default ""
endif

menuconfig HAS_VIRTIO_RNG
  depends on !SOC_SIM
  bool "Enable virtio-mmio random number generator"
  default n

menuconfig HAS_VIRTIO_NET
  depends on !SOC_SIM
  bool "Enable virtio-mmio network device"
  default n

menuconfig HAS_GOLDFISH_RTC
  depends on !SOC_SIM
  bool "Enable goldfish RTC"
  default n
  help
    Goldfish RTC 的 alarm 通过 generic RISC-V PLIC 投递。ysyxSoC profile
    没有 PLIC，因此不会把这个设备作为无效的“可配置但不可投递”能力暴露。

menuconfig HAS_SYSCON_RESET
  bool "Enable syscon reset/poweroff"
  default n

if HAS_SYSCON_RESET
config SYSCON_POWEROFF_VALUE
  hex "Poweroff value"
  default 0x5555

config SYSCON_REBOOT_VALUE
  hex "Reboot value"
  default 0x7777
endif

menuconfig HAS_SDCARD
  depends on !SOC_SIM
  bool "Enable sdcard"
  default n

if HAS_SDCARD
config SDCARD_CTL_MMIO
  hex "MMIO address of the sdcard controller"
  default 0xa3000000

config SDCARD_IMG_PATH
  string "The path of sdcard image"
  default ""
endif
endif

endif
```
