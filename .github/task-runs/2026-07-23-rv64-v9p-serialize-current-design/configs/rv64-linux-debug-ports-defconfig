## nemu/src/isa/riscv32/Kconfig
```kconfig
menu "ISA-dependent Options for riscv"

config RV64
  bool "64-bit RISC-V architecture"
  default n

config RVE
  bool "Use E extension"
  default n

config RISCV_EXT_M
  bool "Enable M extension (integer multiply/divide)"
  default y
  help
    控制 NEMU 是否接受 RV32M 指令编码。关闭后，mul/div/rem 等编码会按
    illegal instruction trap 处理；AM guest 编译参数也会同步移除 m。

config RISCV_EXT_B
  bool "Enable B extension (Zba/Zbb/Zbc/Zbs bit manipulation)"
  default n
  help
    控制 NEMU 是否接受当前 GCC 已拆分命名的 bitmanip 子扩展：
    Zba/Zbb/Zbc/Zbs。AM guest 编译参数会同步追加
    _zba_zbb_zbc_zbs，而不是使用 GCC 不接受默认版本的裸 b。

config RISCV_EXT_C
  bool "Enable C extension (compressed instructions)"
  default n
  help
    控制 NEMU 是否按 16/32 位可变长度取指并执行 RV32C 压缩整数指令；
    AM guest 编译参数会同步追加 c。

config SOC_SIM
  depends on !RV64 && MODE_SYSTEM
  bool "Enable ysyxSoC platform simulation map"
  default n
  help
    打开后，NEMU 会在 paddr 层直接模拟当前 NPC/ysyxSoC 使用的
    SoC 地址图和最小设备窗口，例如 SRAM、UART16550、SPI/GPIO/PS2
    占位寄存器、MROM、VGA、Flash 和 SDRAM。

    该模型不依赖 CONFIG_DEVICE，因此构建 NPC difftest reference so
    时也能处理 SoC MMIO/内存访问。默认关闭，避免普通 AM/NEMU
    legacy 设备地址和严格 SoC 地址图互相覆盖。
endmenu
```

## nemu/src/isa/riscv64/Kconfig
```kconfig
menu "ISA-dependent Options for riscv64"

config RISCV_EXT_M
  bool "Enable M extension (integer multiply/divide)"
  default y
  help
    控制 NEMU 是否接受 RV64M 指令编码。关闭后，mul/div/rem 等编码会按
    illegal instruction trap 处理；AM guest 编译参数也会同步移除 m。

config RISCV_EXT_A
  bool "Enable A extension (atomic memory operations)"
  default n
  help
    控制 NEMU 是否接受 LR/SC/AMO 指令。RV64 Linux/OpenSBI 常用 AMO
    实现自旋锁和原子变量，因此 Linux 平台配置需要显式打开。

config RISCV_EXT_F
  bool "Enable F extension (single-precision floating point)"
  default n
  help
    控制 NEMU 是否接受浮点寄存器相关基础指令。Linux/Ubuntu 的
    rv64gc 用户态启动会通过内核 fstate 路径使用 F/D 寄存器搬运。

config RISCV_EXT_D
  bool "Enable D extension (double-precision floating point)"
  depends on RISCV_EXT_F
  default n
  help
    控制 NEMU 是否接受双精度浮点寄存器搬运指令。当前 Linux bring-up
    至少需要 fld/fsd 以及对应压缩指令恢复用户态浮点上下文。

config RISCV_EXT_B
  bool "Enable B extension (Zba/Zbb/Zbc/Zbs bit manipulation)"
  default n
  help
    控制 NEMU 是否接受当前 GCC 已拆分命名的 bitmanip 子扩展：
    Zba/Zbb/Zbc/Zbs。AM guest 编译参数会同步追加
    _zba_zbb_zbc_zbs，而不是使用 GCC 不接受默认版本的裸 b。

config RISCV_EXT_C
  bool "Enable C extension (compressed instructions)"
  default n
  help
    控制 NEMU 是否按 16/32 位可变长度取指并执行 RV64C 压缩整数指令；
    AM guest 编译参数会同步追加 c。

config RISCV_CLINT_HOST_TIME
  bool "Use host monotonic time for RV64 CLINT mtime"
  default n
  help
    让 RV64 CLINT mtime/CSR time 以宿主 monotonic time 为基准前进，WFI
    只做短 host sleep，不再虚拟快进到下一次 mtimecmp。Linux/Ubuntu 用户态
    会用 CLOCK_MONOTONIC 驱动 sshd、systemd 和 timerfd 等真实时间语义；
    慢速解释执行下若继续把 CPU 指令数或 idle 快进当时间，OpenSSH 等程序的
    毫秒级延迟可能被放大成分钟级。
    AM/指令级实验可继续关闭本选项，保留旧的 instruction-time 语义。
endmenu
```

## nemu/src/memory/Kconfig
```kconfig
menu "Memory Configuration"

config MBASE
  hex "Memory base address"
  default 0x0        if ISA_x86
  default 0x80000000

config MSIZE
  hex "Memory size"
  default 0x8000000

config PC_RESET_OFFSET
  hex "Offset of reset vector from the base of memory"
  default 0x100000 if ISA_x86
  default 0

choice
  prompt "Physical memory definition"
  default PMEM_GARRAY
config PMEM_MALLOC
  bool "Using malloc()"
config PMEM_GARRAY
  depends on !TARGET_AM
  bool "Using global array"
endchoice

config MEM_RANDOM
  depends on MODE_SYSTEM && !DIFFTEST && !TARGET_AM && !PERFORMANCE
  bool "Initialize the memory with random values"
  default y
  help
    This may help to find undefined behaviors.

config CACHE
  depends on TARGET_NATIVE_ELF
  bool "Enable ICache and DCache model"
  default y
  help
    在 vaddr 层启用透明的 ICache/DCache 模型；MMIO 仍直通 paddr 层，避免破坏设备副作用。

config CACHE_STATISTIC
  depends on CACHE && !PERFORMANCE
  bool "Print cache access counters"
  default y
  help
    控制退出时是否打印 ICache/DCache access/hit/miss/writeback 统计；关闭后仍会
    在 cache_statistic() 中执行必要的 DCache flush，避免统计开关改变功能结果。

config ICACHE_SIZE
  depends on CACHE
  int "ICache size in bytes"
  default 4096

config DCACHE_SIZE
  depends on CACHE
  int "DCache size in bytes"
  default 4096

config CACHE_LINE_SIZE
  depends on CACHE
  int "Cache line size in bytes"
  default 64

endmenu #MEMORY
```

## npc/pack/rv64core-legacy-20260916/rv64/configs/rv64_perf_defconfig
```kconfig
# perf-sim 配置：仅保留最小外设和进度输出，用于 CoreMark/Linux 性能基线。
# perf 模式:编译期关掉所有 trace + 统计(含 RTL 观测探针),最快仿真。
CONFIG_NPC_PERF_MODE=y
CONFIG_CC_GPP=y
CONFIG_CC="g++"
CONFIG_CC_O3=y
CONFIG_CC_OPT="-O3"
CONFIG_CC_DEBUG=n
CONFIG_NPC_DEFAULT_MAX_CYCLES=0
CONFIG_NPC_DEFAULT_LOG_PATH="build/npc-log.txt"
CONFIG_NPC_BATCH_MODE=y
CONFIG_NPC_STDIN_KEYBOARD=n
CONFIG_NPC_HAS_VGA=n
CONFIG_NPC_TRACE_BY_DEFAULT=n
CONFIG_NPC_COLORED_LOG=y
CONFIG_NPC_LOG_FILE=n
CONFIG_NPC_PROGRESS_BY_DEFAULT=y
CONFIG_NPC_DEFAULT_PROGRESS_INTERVAL=10000000
CONFIG_NPC_DIFFTEST=n
CONFIG_NPC_SDB=n
CONFIG_NPC_EXPR=n
CONFIG_NPC_WATCHPOINT=n
CONFIG_NPC_TEXT_TRACE=n
```

## npc/rv64/Kconfig
```kconfig
mainmenu "NPC RV64 Configuration Menu"

menu "Build Options"

choice
  prompt "Compiler"
  default CC_GPP

config CC_GPP
  bool "g++"

config CC_CLANGPP
  bool "clang++"
endchoice

config CC
  string
  default "g++" if CC_GPP
  default "clang++" if CC_CLANGPP
  default "g++"

choice
  prompt "Optimization Level"
  default CC_O3

config CC_O0
  bool "O0"

config CC_O1
  bool "O1"

config CC_O2
  bool "O2"

config CC_O3
  bool "O3"
endchoice

config CC_OPT
  string
  default "-O0" if CC_O0
  default "-O1" if CC_O1
  default "-O2" if CC_O2
  default "-O3" if CC_O3
  default "-O3"

config CC_DEBUG
  bool "Enable debug information"
  default n

config NPC_DEFAULT_MAX_CYCLES
  int "Default max cycles before timeout (0 = unlimited)"
  default 2000000
  help
    Set the default cycle timeout for NPC runs.
    Use 0 to disable the timeout when running large tests.

config NPC_DEFAULT_LOG_PATH
  string "Default log path"
  default "build/npc-log.txt"

config NPC_BATCH_MODE
  bool "Start in batch mode by default (-b)"
  default y

config NPC_STDIN_KEYBOARD
  bool "Enable stdin keyboard by default"
  default n

config NPC_HAS_VGA
  bool "Enable VGA MMIO device"
  default y
  help
    Expose vgactl/framebuffer MMIO to the guest. When disabled, AM GPU config
    will report present=false and VGA accesses become harmless no-ops.

config NPC_TRACE_BY_DEFAULT
  bool "Enable wave trace by default"
  depends on !NPC_PERF_MODE
  default n

endmenu

menu "Monitor and Debugging"

config NPC_COLORED_LOG
  bool "Enable colored log output"
  default y

config NPC_LOG_FILE
  bool "Enable file log output by default"
  default n

config NPC_PROGRESS_BY_DEFAULT
  bool "Enable progress report by default"
  default y
  help
    Print periodic execution progress during long-running continuous runs by
    default. This only controls the startup default; command-line options can
    still override it with --progress or --no-progress.

config NPC_DEFAULT_PROGRESS_INTERVAL
  int "Default progress report interval in commits"
  depends on NPC_PROGRESS_BY_DEFAULT
  default 10000000
  help
    Number of committed instructions between two progress reports when default
    progress reporting is enabled.

config NPC_DIFFTEST
  bool "Build difftest support"
  default n
  help
    Build the NPC-to-reference DiffTest runtime and enable it by default at
    startup. Use --no-diff for one-off bare runs, or disable this in
    performance configs to omit the reference loader and commit hot-path
    difftest checks entirely.

config NPC_SDB
  bool "Enable monitor debugger"
  default y

config NPC_EXPR
  depends on NPC_SDB
  bool "Enable expression evaluator"
  default y

config NPC_WATCHPOINT
  depends on NPC_EXPR
  bool "Enable watchpoint feature"
  default y

config NPC_TEXT_TRACE
  bool "Build text trace support"
  depends on !NPC_PERF_MODE
  default n
  help
    Build the software text trace framework. When disabled, itrace/mtrace/dtrace
    code paths are compiled out together. When enabled, runtime defaults and
    command-line options decide which trace streams are actually printed.

if NPC_TEXT_TRACE

config NPC_ITRACE_BY_DEFAULT
  bool "Enable commit trace by default at runtime"
  default n
  help
    Turn itrace on at startup without requiring --itrace or monitor commands.
    This is useful when you want file logs to behave more like NEMU's trace logs.

config NPC_ITRACE_COND
  depends on NPC_EXPR
  string "Default itrace condition"
  default "true"

config NPC_MTRACE_BY_DEFAULT
  bool "Enable memory access trace by default at runtime"
  default n
  help
    Turn mtrace on at startup without requiring --mtrace or monitor commands.

config NPC_DTRACE_BY_DEFAULT
  bool "Enable device access trace by default at runtime"
  default n
  help
    Turn dtrace on at startup without requiring --dtrace or monitor commands.

endif

endmenu

menu "Statistics and Profiling"

config NPC_PERF_MODE
  bool "Performance mode (compile out ALL trace & statistics)"
  default n
  help
    Master speed switch. When enabled, every software text trace
    (itrace/mtrace/dtrace/wave) and every statistic — summary (CPI/cycles),
    branch/BPU, cache, OoO pipeline — is compiled out, including the RTL
    observation probes and their per-event DPI cost. Overrides and hides all
    the trace/statistic switches below.

config NPC_SUMMARY_STATS
  bool "Summary statistics (guest insts/cycles, CPI, CLINT mtime, host time)"
  depends on !NPC_PERF_MODE
  default y
  help
    End-of-run summary block. Software-only (no RTL probe), cheap. The
    HIT GOOD/BAD TRAP result line (cycles/commits) is always printed
    regardless of this option.

config NPC_SIM_STATS
  bool "Microarchitecture statistics (RTL observation-probe network)"
  depends on !NPC_PERF_MODE
  default y
  help
    Master for the shared RTL probe network (sim_*_w) that feeds the
    branch/cache/OoO statistics below. Turning this (or perf mode) off removes
    all probe wiring and the per-event DPI crossing. Pick categories below.

if NPC_SIM_STATS

config NPC_BRANCH_STATS
  bool "Branch / jump / BPU / RAS / BTB statistics"
  default y
  help
    Conditional-branch/JAL/JALR counts and direction/BTB/RAS prediction
    accuracy. Feeds npc_bpu_lookup_event / npc_bpu_resolve_event probes.

config NPC_CACHE_STATS
  bool "I-cache / D-cache statistics"
  default y
  help
    icache/dcache access/hit/miss and writeback counters. Feeds
    npc_icache_event / npc_dcache_event probes.

config NPC_OOO_STATS
  bool "OoO pipeline statistics (retire/exec/dispatch hist + window)"
  default y
  help
    Per-cycle OoO occupancy/stall histograms and the periodic window report.
    Feeds the npc_ooo_cycle_event probe (heaviest, fires every cycle).

endif # NPC_SIM_STATS

config NPC_DEBUG_PORTS
  bool "RTL debug observation ports (abort-time pipeline state dump)"
  depends on !NPC_PERF_MODE
  default n
  help
    Wide debug hierarchy ports used for the abort-time pipeline dump and deep
    waveform observation. Independent of statistics; off by default.

endmenu
```

## npc/rv64/configs/rv64_linux_defconfig
```kconfig
# Linux/OpenSBI 长跑配置：关闭 difftest/trace，把时间花在 guest boot 本身。
CONFIG_CC_GPP=y
CONFIG_CC="g++"
CONFIG_CC_O3=y
CONFIG_CC_OPT="-O3"
CONFIG_CC_DEBUG=n
CONFIG_NPC_DEFAULT_MAX_CYCLES=100000000
CONFIG_NPC_DEFAULT_LOG_PATH="build/linux-logs/npc-linux.log"
CONFIG_NPC_BATCH_MODE=y
CONFIG_NPC_STDIN_KEYBOARD=n
CONFIG_NPC_HAS_VGA=n
CONFIG_NPC_TRACE_BY_DEFAULT=n
CONFIG_NPC_COLORED_LOG=y
CONFIG_NPC_LOG_FILE=y
CONFIG_NPC_PROGRESS_BY_DEFAULT=y
CONFIG_NPC_DEFAULT_PROGRESS_INTERVAL=10000000
CONFIG_NPC_DIFFTEST=n
CONFIG_NPC_SDB=n
CONFIG_NPC_EXPR=n
CONFIG_NPC_WATCHPOINT=n
CONFIG_NPC_TEXT_TRACE=n
```

## npc/rv64/configs/rv64_soc_defconfig
```kconfig
# soc-sim 配置：保留调试和 difftest，用于地址图/SoC 兼容验证，不用于 Linux 长跑。
CONFIG_CC_GPP=y
CONFIG_CC="g++"
CONFIG_CC_O3=y
CONFIG_CC_OPT="-O3"
CONFIG_CC_DEBUG=n
CONFIG_NPC_DEFAULT_MAX_CYCLES=2000000
CONFIG_NPC_DEFAULT_LOG_PATH="build/npc-soc.log"
CONFIG_NPC_BATCH_MODE=y
CONFIG_NPC_STDIN_KEYBOARD=n
CONFIG_NPC_HAS_VGA=y
CONFIG_NPC_TRACE_BY_DEFAULT=n
CONFIG_NPC_COLORED_LOG=y
CONFIG_NPC_LOG_FILE=y
CONFIG_NPC_PROGRESS_BY_DEFAULT=y
CONFIG_NPC_DEFAULT_PROGRESS_INTERVAL=10000000
CONFIG_NPC_DIFFTEST=y
CONFIG_NPC_SDB=y
CONFIG_NPC_EXPR=y
CONFIG_NPC_WATCHPOINT=y
CONFIG_NPC_TEXT_TRACE=y
CONFIG_NPC_ITRACE_BY_DEFAULT=n
CONFIG_NPC_ITRACE_COND="true"
CONFIG_NPC_MTRACE_BY_DEFAULT=n
CONFIG_NPC_DTRACE_BY_DEFAULT=n
```

## npc/rv64/configs/rv64_trace_defconfig
```kconfig
# trace 配置：用于 Linux boot 卡点定位，不作为性能基线。
CONFIG_CC_GPP=y
CONFIG_CC="g++"
CONFIG_CC_O3=y
CONFIG_CC_OPT="-O3"
CONFIG_CC_DEBUG=y
CONFIG_NPC_DEFAULT_MAX_CYCLES=20000000
CONFIG_NPC_DEFAULT_LOG_PATH="build/linux-logs/npc-trace.log"
CONFIG_NPC_BATCH_MODE=y
CONFIG_NPC_STDIN_KEYBOARD=n
CONFIG_NPC_HAS_VGA=n
CONFIG_NPC_TRACE_BY_DEFAULT=n
CONFIG_NPC_COLORED_LOG=y
CONFIG_NPC_LOG_FILE=y
CONFIG_NPC_PROGRESS_BY_DEFAULT=y
CONFIG_NPC_DEFAULT_PROGRESS_INTERVAL=1000000
CONFIG_NPC_DIFFTEST=n
CONFIG_NPC_SDB=y
CONFIG_NPC_EXPR=y
CONFIG_NPC_WATCHPOINT=y
CONFIG_NPC_TEXT_TRACE=y
CONFIG_NPC_ITRACE_BY_DEFAULT=n
CONFIG_NPC_ITRACE_COND="true"
CONFIG_NPC_MTRACE_BY_DEFAULT=n
CONFIG_NPC_DTRACE_BY_DEFAULT=n
```

## npc/sim/Kconfig
```kconfig
mainmenu "NPC Simulation Top Configuration Menu"

menu "Backend Selection"

choice
  prompt "Simulation backend"
  default NPC_SIM_BACKEND_SINGLE
  help
    Select the concrete backend used by the platform-independent npc/sim
    entry. External modules such as Abstract Machine should call npc/sim,
    while this choice decides whether the real Verilator model comes from
    npc/single or npc/soc.

config NPC_SIM_BACKEND_SINGLE
  bool "single: AM/NpcSimTop self-simulation backend"
  help
    Use npc/single as the concrete backend. This is the default path for
    AM/riscv32-npc programs and does not instantiate ysyxSoCFull.

config NPC_SIM_BACKEND_SOC
  bool "soc: ysyxSoC integration copy backend"
  help
    Use npc/soc as the concrete backend. The normal run/lint targets still
    use its copied NpcSimTop backend, while soc/soc-lint build the
    ysyxSoCFull integration top.

endchoice

config NPC_SIM_BACKEND
  string
  default "single" if NPC_SIM_BACKEND_SINGLE
  default "soc" if NPC_SIM_BACKEND_SOC
  default "single"

endmenu
```

## npc/single/configs/perf_defconfig
```kconfig
# 性能测试专用 defconfig — 关闭所有 trace 和日志，追求极速
CONFIG_CC_GPP=y
CONFIG_CC="g++"
CONFIG_CC_O3=y
CONFIG_CC_OPT="-O3"
CONFIG_CC_DEBUG=n
CONFIG_NPC_DEFAULT_MAX_CYCLES=0
CONFIG_NPC_DEFAULT_LOG_PATH="build/npc-log.txt"
CONFIG_NPC_BATCH_MODE=y
CONFIG_NPC_STDIN_KEYBOARD=n
CONFIG_NPC_HAS_VGA=n
CONFIG_NPC_TRACE_BY_DEFAULT=n
CONFIG_NPC_COLORED_LOG=y
CONFIG_NPC_LOG_FILE=n
CONFIG_NPC_PROGRESS_BY_DEFAULT=y
CONFIG_NPC_DEFAULT_PROGRESS_INTERVAL=10000000
CONFIG_NPC_DIFFTEST=n
CONFIG_NPC_SDB=n
CONFIG_NPC_EXPR=n
CONFIG_NPC_WATCHPOINT=n
CONFIG_NPC_ITRACE=n
CONFIG_NPC_MTRACE=n
CONFIG_NPC_DTRACE=n
```
