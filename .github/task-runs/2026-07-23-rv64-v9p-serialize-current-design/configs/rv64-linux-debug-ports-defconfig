## nemu/configs/riscv32-soc_defconfig
```kconfig
CONFIG_ISA_riscv=y
CONFIG_RISCV_EXT_B=y
CONFIG_RISCV_EXT_C=y
CONFIG_SOC_SIM=y
CONFIG_MBASE=0x80000000
CONFIG_MSIZE=0x00400000
CONFIG_TARGET_NATIVE_ELF=y
CONFIG_CC_GCC=y
CONFIG_CC_O2=y
CONFIG_DEVICE=y
# CONFIG_DEVICE_MAP_LEGACY is not set
# CONFIG_HAS_SERIAL is not set
# CONFIG_HAS_TIMER is not set
# CONFIG_HAS_KEYBOARD is not set
# CONFIG_HAS_VGA is not set
# CONFIG_HAS_AUDIO is not set
# CONFIG_HAS_DISK is not set
# CONFIG_HAS_VIRTIO_RNG is not set
# CONFIG_HAS_VIRTIO_NET is not set
# CONFIG_HAS_GOLDFISH_RTC is not set
CONFIG_HAS_SYSCON_RESET=y
CONFIG_SYSCON_POWEROFF_VALUE=0x5555
CONFIG_SYSCON_REBOOT_VALUE=0x7777
# CONFIG_HAS_SDCARD is not set
CONFIG_PMEM_GARRAY=y
# CONFIG_TRACE is not set
```

## nemu/configs/riscv64-linux-gui_defconfig
```kconfig
CONFIG_RV64=y
CONFIG_RISCV_EXT_M=y
CONFIG_RISCV_EXT_A=y
CONFIG_RISCV_EXT_F=y
CONFIG_RISCV_EXT_D=y
CONFIG_RISCV_EXT_C=y
CONFIG_RISCV_CLINT_HOST_TIME=y
CONFIG_TARGET_NATIVE_ELF=y
CONFIG_CC_GCC=y
CONFIG_CC_O2=y
CONFIG_PERFORMANCE=y
CONFIG_INTERPRETER_BASIC_BLOCK=y
CONFIG_INTERPRETER_TB_MAX_INST=256
CONFIG_INTERPRETER_WIDE_IFETCH=y
CONFIG_INTERPRETER_IFETCH_PAGE_CACHE=y
CONFIG_INTERPRETER_INTR_FAST_FLAG=y
CONFIG_DEVICE=y
# CONFIG_DEVICE_MAP_LEGACY is not set
CONFIG_BATCH_MODE=y
CONFIG_MSIZE=0x40000000
CONFIG_PMEM_MALLOC=y
# CONFIG_MEM_RANDOM is not set
# CONFIG_CACHE is not set
CONFIG_HAS_SERIAL=y
CONFIG_SERIAL_INPUT_FIFO=y
CONFIG_SERIAL_INPUT_STDIN=y
CONFIG_SERIAL_INPUT_HOST_POLL_INTERVAL=4
# CONFIG_HAS_TIMER is not set
# CONFIG_HAS_KEYBOARD is not set
CONFIG_HAS_VGA=y
CONFIG_VGA_SHOW_SCREEN=y
CONFIG_VGA_AUTO_SCANOUT=y
# CONFIG_VGA_SIZE_400x300 is not set
CONFIG_VGA_SIZE_800x600=y
# CONFIG_HAS_AUDIO is not set
CONFIG_HAS_DISK=y
CONFIG_DISK_IMG_PATH=""
CONFIG_HAS_VIRTIO_RNG=y
CONFIG_HAS_VIRTIO_NET=y
CONFIG_HAS_VIRTIO_INPUT=y
CONFIG_HAS_GOLDFISH_RTC=y
CONFIG_HAS_SYSCON_RESET=y
CONFIG_SYSCON_POWEROFF_VALUE=0x5555
CONFIG_SYSCON_REBOOT_VALUE=0x7777
# CONFIG_TRACE is not set
```

## nemu/configs/riscv64-linux_debug_defconfig
```kconfig
CONFIG_RV64=y
CONFIG_RISCV_EXT_M=y
CONFIG_RISCV_EXT_A=y
CONFIG_RISCV_EXT_F=y
CONFIG_RISCV_EXT_D=y
CONFIG_RISCV_EXT_C=y
CONFIG_ENGINE_INTERPRETER=y
CONFIG_MODE_SYSTEM=y
CONFIG_TARGET_NATIVE_ELF=y
CONFIG_CC_GCC=y
CONFIG_CC_O2=y
# CONFIG_PERFORMANCE is not set
CONFIG_DEVICE=y
CONFIG_BATCH_MODE=y
CONFIG_MSIZE=0x20000000
CONFIG_PMEM_MALLOC=y
# CONFIG_MEM_RANDOM is not set
# CONFIG_CACHE is not set
CONFIG_HAS_SERIAL=y
CONFIG_SERIAL_MMIO=0x10000000
CONFIG_SERIAL_INPUT_FIFO=y
CONFIG_SERIAL_INPUT_STDIN=y
# CONFIG_HAS_TIMER is not set
# CONFIG_HAS_KEYBOARD is not set
# CONFIG_HAS_VGA is not set
# CONFIG_HAS_AUDIO is not set
CONFIG_HAS_DISK=y
CONFIG_DISK_CTL_MMIO=0x10001000
CONFIG_DISK_IMG_PATH=""
CONFIG_HAS_VIRTIO_RNG=y
CONFIG_VIRTIO_RNG_MMIO=0x10002000
CONFIG_HAS_GOLDFISH_RTC=y
CONFIG_GOLDFISH_RTC_MMIO=0x10003000
CONFIG_TRACE=y
# CONFIG_MTRACE is not set
# CONFIG_ITRACE is not set
# CONFIG_DTRACE is not set
# CONFIG_ETRACE is not set
# CONFIG_FTRACE is not set
CONFIG_STATISTIC=y
CONFIG_RISCV_DEBUG_LOG=y
CONFIG_RISCV_FAULT_DEBUG_BUDGET=2048
CONFIG_RISCV_PROGRESS_DEBUG_LOG=y
CONFIG_RISCV_PROGRESS_DEBUG_INTERVAL=100000000
CONFIG_RISCV_IRQ_DEBUG_LOG=y
CONFIG_RISCV_SYSCALL_DEBUG_LOG=y
CONFIG_RISCV_SYSCALL_DEBUG_BUDGET=4096
```

## nemu/configs/riscv64-linux_defconfig
```kconfig
CONFIG_RV64=y
CONFIG_RISCV_EXT_M=y
CONFIG_RISCV_EXT_A=y
CONFIG_RISCV_EXT_F=y
CONFIG_RISCV_EXT_D=y
CONFIG_RISCV_EXT_C=y
CONFIG_RISCV_CLINT_HOST_TIME=y
CONFIG_TARGET_NATIVE_ELF=y
CONFIG_CC_GCC=y
CONFIG_CC_O2=y
CONFIG_PERFORMANCE=y
CONFIG_INTERPRETER_BASIC_BLOCK=y
CONFIG_INTERPRETER_TB_MAX_INST=256
CONFIG_INTERPRETER_WIDE_IFETCH=y
CONFIG_INTERPRETER_IFETCH_PAGE_CACHE=y
CONFIG_INTERPRETER_INTR_FAST_FLAG=y
CONFIG_DEVICE=y
CONFIG_BATCH_MODE=y
CONFIG_MSIZE=0x40000000
CONFIG_PMEM_MALLOC=y
# CONFIG_MEM_RANDOM is not set
# CONFIG_CACHE is not set
CONFIG_HAS_SERIAL=y
CONFIG_SERIAL_INPUT_FIFO=y
CONFIG_SERIAL_INPUT_STDIN=y
CONFIG_SERIAL_INPUT_HOST_POLL_INTERVAL=4
# CONFIG_HAS_TIMER is not set
# CONFIG_HAS_KEYBOARD is not set
# CONFIG_HAS_VGA is not set
# CONFIG_HAS_AUDIO is not set
CONFIG_HAS_DISK=y
CONFIG_DISK_IMG_PATH=""
CONFIG_HAS_VIRTIO_RNG=y
CONFIG_HAS_VIRTIO_NET=y
CONFIG_HAS_GOLDFISH_RTC=y
CONFIG_HAS_SYSCON_RESET=y
CONFIG_SYSCON_POWEROFF_VALUE=0x5555
CONFIG_SYSCON_REBOOT_VALUE=0x7777
# CONFIG_TRACE is not set
```

## nemu/configs/riscv64-npc_defconfig
```kconfig
CONFIG_RV64=y
CONFIG_RISCV_EXT_M=y
CONFIG_RISCV_EXT_A=y
CONFIG_RISCV_EXT_B=y
CONFIG_RISCV_EXT_C=y
CONFIG_TARGET_NATIVE_ELF=y
CONFIG_CC_GCC=y
CONFIG_CC_O2=y
CONFIG_DEVICE=y
CONFIG_MSIZE=0x40000000
CONFIG_PMEM_MALLOC=y
# CONFIG_MEM_RANDOM is not set
# CONFIG_TRACE is not set
CONFIG_RISCV_EXT_F=y
CONFIG_RISCV_EXT_D=y
CONFIG_HAS_SERIAL=y
# CONFIG_HAS_TIMER is not set
# CONFIG_HAS_KEYBOARD is not set
# CONFIG_HAS_VGA is not set
# CONFIG_HAS_AUDIO is not set
CONFIG_HAS_DISK=y
CONFIG_DISK_IMG_PATH=""
CONFIG_HAS_VIRTIO_RNG=y
CONFIG_HAS_VIRTIO_NET=y
CONFIG_HAS_GOLDFISH_RTC=y
CONFIG_HAS_SYSCON_RESET=y
CONFIG_SYSCON_POWEROFF_VALUE=0x5555
CONFIG_SYSCON_REBOOT_VALUE=0x7777
```

## nemu/src/cpu/Kconfig
```kconfig
menu "CPU Performance Models"
  depends on TARGET_NATIVE_ELF && ISA_riscv

config INTERPRETER_BASIC_BLOCK
  depends on ENGINE_INTERPRETER && PERFORMANCE
  bool "Enable conservative interpreter basic-block batching"
  default y
  help
    在 Ubuntu/Linux performance 配置下，把普通连续指令按小块执行：
    中断查询和设备轮询只在块边界发生；遇到分支、跳转、SYSTEM、
    store/AMO、fence 或压缩控制/存储指令时立即结束当前块。该选项
    不做译码缓存或 JIT，只是 basic block interpreter 的第一阶段。

config INTERPRETER_TB_MAX_INST
  depends on INTERPRETER_BASIC_BLOCK
  int "Maximum instructions in one interpreter basic block"
  range 1 256
  default 32 if PERFORMANCE
  default 16
  help
    单个解释器 basic block 最多连续退休的 guest 指令数。Ubuntu performance
    配置使用 32，减少无控制流/无设备可见副作用的直线代码反复回到主循环；
    遇到分支、跳转、SYSTEM、store/AMO、fence 或压缩控制/存储指令仍会提前
    收束，因此该值只是保守上限，不是 TB chaining 或 JIT。

config INTERPRETER_WIDE_IFETCH
  depends on INTERPRETER_BASIC_BLOCK && RISCV_EXT_C
  bool "Enable one-translation wide ifetch for RVC"
  default y
  help
    在同页 PMEM host pointer 命中时，一次读取 4 字节并用低 2 bit 判断
    当前是 16-bit 压缩指令还是 32-bit 指令，减少 RV64C 热路径中
    两次 vaddr/MMU/TLB 取指。跨页、MMIO 或 fault 场景仍回退旧精确路径。

config INTERPRETER_IFETCH_PAGE_CACHE
  depends on INTERPRETER_WIDE_IFETCH && RV64 && !CACHE && !MTRACE
  bool "Cache current ifetch host page"
  default y if PERFORMANCE
  default n
  help
    在 RV64 Ubuntu performance 配置下，为 wide ifetch 额外缓存当前取指
    虚拟页对应的 PMEM host page。命中条件包含 vaddr page、satp 和当前特权级；
    sfence.vma、fence.i、全量 TLB flush 和写入当前缓存页都会失效。该项只是
    单页 host pointer 快路径，不是完整代码页失效体系、TB cache 或 JIT。

config INTERPRETER_DECODE_CACHE
  depends on INTERPRETER_BASIC_BLOCK
  bool "Enable conservative interpreter decode cache"
  default y
  help
    在解释器热路径中缓存 PC+原始指令对应的预译码字段，包括常见整数、
    load/store、AMO、分支跳转和压缩指令分发类别。命中时仍先真实取指并
    比对原始指令，保证自修改代码或页重映射后会自动回到慢路径重新译码；
    fence.i 会显式清空缓存。该选项不是完整 TB cache 或 JIT。

config INTERPRETER_DECODE_DIRECT_DISPATCH
  depends on INTERPRETER_DECODE_CACHE && RV64
  bool "Use direct dispatch for decode cache hits"
  default y if PERFORMANCE
  default n
  help
    在 RV64 Ubuntu performance 配置下，decode-cache 命中后使用 GNU C
    computed-goto 分发表直接跳转到对应执行块，减少二次 switch(kind)
    分发开销。该项只优化预译码 cache 命中路径，不改变取指、译码、
    fence.i 失效或异常语义，也不是 TB chaining、host code cache 或 JIT。

config INTERPRETER_DECODE_CACHE_ENTRIES
  depends on INTERPRETER_DECODE_CACHE
  int "Interpreter decode cache entries"
  range 1024 65536
  default 32768 if PERFORMANCE
  default 8192
  help
    预译码 cache 的 direct-mapped entry 数。Ubuntu performance 配置使用更大的
    32768 项以降低大型用户态/内核工作集冲突；普通配置保持较小默认值，避免
    无关场景增加静态内存占用。该值必须保持 2 的幂，否则编译期会拒绝。

config INTERPRETER_INTR_FAST_FLAG
  depends on INTERPRETER_BASIC_BLOCK && RV64
  bool "Enable fast interrupt pending guard at TB boundary"
  default y
  help
    在 basic-block 解释器块边界先做一个保守的 pending/enable/global
    快速判断；只有存在可能可投递中断时才进入完整 isa_query_intr()
    路径。该选项不改变 CLINT/PLIC/CSR 语义，只减少无中断热路径的
    重复 pending 计算。

config BPU
  depends on TARGET_NATIVE_ELF && ISA_riscv && !PERFORMANCE
  bool "Enable branch prediction model"
  default y
  help
    启用透明的 BPU 统计模型。它不会改变 NEMU 的真实执行 PC，只在控制流
    指令提交时用 BTB/BHT/RAS 预测并和真实 dnpc 对比，便于观察分支预测效果。

config BPU_BTB_ENTRIES
  depends on BPU
  int "BPU BTB entries"
  range 1 4096
  default 128

config BPU_BHT_ENTRIES
  depends on BPU
  int "BPU BHT entries"
  range 1 8192
  default 256

config BPU_RAS_ENTRIES
  depends on BPU
  int "BPU RAS entries"
  range 1 128
  default 16

config BPU_COUNTER_BITS
  depends on BPU
  int "BPU saturating counter bits"
  range 1 8
  default 2

config BPU_COUNTER_INIT
  depends on BPU
  int "BPU initial counter value"
  range 0 255
  default 1
  help
    2-bit 计数器默认值 1 表示 weakly not-taken；若调大 COUNTER_BITS，
    该值仍必须小于等于该位宽下的最大计数值。

config BPU_GHR_BITS
  depends on BPU
  int "BPU global history bits"
  range 0 16
  default 0
  help
    0 表示 BHT 只按 PC 索引；大于 0 时用 PC 和全局分支历史异或索引 BHT。

endmenu
```

## nemu/src/device/Kconfig
```kconfig
menuconfig DEVICE
  depends on !TARGET_SHARE
  bool "Devices"
  default n
  help
    Provide device support for NEMU.

config DEVICE_UPDATE_CHECK_INTERVAL
  int "Guest instructions between host device polls"
  range 1 4096
  default 512 if PERFORMANCE
  default 64
  help
    device_update_after_inst() 先按 guest retired 指令数做一层粗粒度节流，
    再按宿主时间维持约 60Hz 的串口/RTC/VGA/SDL 刷新语义。Ubuntu
    performance 配置没有 VGA/keyboard/audio，适合使用更大的指令间隔来
    减少解释器热路径轮询开销；调试/交互配置保持较小默认值。

if DEVICE

config DEVICE_MAP_LEGACY
  bool "Use legacy AM device map (0xa0000000 family)"
  default n
  help
    设备地址默认走统一的 Linux/SoC 图 (见 include/device/device_address.h,
    与 AM/NPC 三方一致)。仅当为封存的 RV32 旧目标构建 difftest 参考时置 y,
    切回旧 AM 图 (serial 0xa00003f8 / rtc 0xa0000048 ...)。

config HAS_PORT_IO
  bool
  default y if ISA_x86
  default n

menuconfig HAS_SERIAL
  bool "Enable serial"
  default y

if HAS_SERIAL
config SERIAL_PORT
  depends on HAS_PORT_IO
  hex "Port address of the serial controller"
  default 0x3f8

config SERIAL_MMIO
  hex "MMIO address of the serial controller"
  # RV64 system mode follows Linux/platform/npc-rv64.yml and generated DTB.
  default 0x10000000 if ISA64 && MODE_SYSTEM && !TARGET_AM
  default 0xa00003f8

config SERIAL_INPUT_FIFO
  depends on !TARGET_AM
  bool "Enable input FIFO with /tmp/nemu.serial"
  default n

config SERIAL_INPUT_STDIN
  depends on !TARGET_AM
  bool "Attach host stdin to serial RX"
  default y if BATCH_MODE
  default n

config SERIAL_INPUT_HOST_POLL_INTERVAL
  depends on SERIAL_INPUT_STDIN || SERIAL_INPUT_FIFO
  int "Host device ticks between serial input polls"
  range 1 64
  default 4 if PERFORMANCE
  default 1
  help
    串口 RX 的宿主 stdin/FIFO 轮询间隔，以 device_update 的 60Hz host
    tick 为单位。Ubuntu performance 配置通常由 focused gate 分块注入输入，
    适合降低空闲时 select/read 频率；guest 主动读取 UART 寄存器时仍会立即
    轮询宿主输入，已进入 staging 的字节也会继续送入 16550 FIFO。
endif # HAS_SERIAL

menuconfig HAS_TIMER
  bool "Enable timer"
  default n if ISA64 && MODE_SYSTEM && !TARGET_AM
  default y

if HAS_TIMER
config RTC_PORT
  depends on HAS_PORT_IO
  hex "Port address of the timer"
  default 0x48

config RTC_MMIO
  hex "MMIO address of the timer"
  default 0xa0000048
endif # HAS_TIMER

menuconfig HAS_KEYBOARD
  bool "Enable keyboard"
  default n if ISA64 && MODE_SYSTEM && !TARGET_AM
  default y

if HAS_KEYBOARD
config I8042_DATA_PORT
  depends on HAS_PORT_IO
  hex "Port address of the keyboard controller"
  default 0x60

config I8042_DATA_MMIO
  hex "MMIO address of the keyboard controller"
  default 0xa0000060
endif # HAS_KEYBOARD

menuconfig HAS_VGA
  bool "Enable VGA"
  default n if ISA64 && MODE_SYSTEM && !TARGET_AM
  default y

if HAS_VGA
config FB_ADDR
  hex "Physical address of the VGA frame buffer"
  default 0xa1000000

config VGA_CTL_PORT
  depends on HAS_PORT_IO
  hex "Port address of the VGA controller"
  default 0x100

config VGA_CTL_MMIO
  hex "MMIO address of the VGA controller"
  default 0xa0000100

config VGA_SHOW_SCREEN
  bool "Enable SDL SCREEN"
  default y

choice
  prompt "Screen Size"
  default VGA_SIZE_400x300
config VGA_SIZE_400x300
  bool "400 x 300"
config VGA_SIZE_800x600
  bool "800 x 600"
endchoice
endif # HAS_VGA

if !TARGET_AM
menuconfig HAS_AUDIO
  bool "Enable audio"
  default n if ISA64 && MODE_SYSTEM
  default y

if HAS_AUDIO
config SB_ADDR
  hex "Physical address of the audio stream buffer"
  default 0xa1200000

config SB_SIZE
  hex "Size of the audio stream buffer"
  default 0x10000

config AUDIO_CTL_PORT
  depends on HAS_PORT_IO
  hex "Port address of the audio controller"
  default 0x200

config AUDIO_CTL_MMIO
  hex "MMIO address of the audio controller"
  default 0xa0000200
endif # HAS_AUDIO

menuconfig HAS_DISK
  bool "Enable disk"
  default y

if HAS_DISK
config DISK_CTL_PORT
  depends on HAS_PORT_IO
  hex "Port address of the disk controller"
  default 0x300

config DISK_CTL_MMIO
  hex "MMIO address of the disk controller"
  # Keep virtio-mmio block adjacent to UART as described by the Linux platform YAML.
  default 0x10001000 if ISA64 && MODE_SYSTEM
  default 0xa0000300

config DISK_IMG_PATH
  string "The path of disk image"
  default ""

config VIRTIO_BLK_ASYNC_COMPLETION_FAST_FLAG
  depends on HAS_DISK && !TARGET_AM
  bool "Skip empty virtio-blk async completion polls"
  default y if PERFORMANCE
  default n
  help
    native NEMU 的 virtio-blk worker 完成 host I/O 后仍由主线程写回
    used ring 和触发 PLIC IRQ。该选项用一个原子 pending flag 保护完成
    队列，空闲 device_update tick 不再反复进入 mutex；有完成项时仍由
    主线程按原路径写 guest PMEM/used ring，不改变 virtio 设备语义。
endif # HAS_DISK

menuconfig HAS_VIRTIO_RNG
  bool "Enable virtio-mmio random number generator"
  default n
  help
    Provide a small modern virtio-mmio RNG device for Linux hwrng.
    Ubuntu/systemd can then use /dev/hwrng instead of relying only on
    /chosen/rng-seed from the bootloader.

if HAS_VIRTIO_RNG
config VIRTIO_RNG_MMIO
  hex "MMIO address of the virtio rng controller"
  default 0x10002000
endif # HAS_VIRTIO_RNG

menuconfig HAS_VIRTIO_NET
  bool "Enable virtio-mmio network device"
  default n
  help
    Provide a small modern virtio-mmio network device for Linux. The
    first slice exposes a stable MAC address and consumes TX descriptors
    so Ubuntu can enumerate a virtio_net interface; host packet forwarding
    is a later device-backend step.

if HAS_VIRTIO_NET
config VIRTIO_NET_MMIO
  hex "MMIO address of the virtio net controller"
  default 0x10004000
endif # HAS_VIRTIO_NET

menuconfig HAS_GOLDFISH_RTC
  bool "Enable goldfish RTC"
  default n
  help
    Provide a small google,goldfish-rtc compatible MMIO device for Linux.
    This gives Ubuntu a wall-clock RTC device instead of relying only on
    CLINT mtime or systemd's software clock.

if HAS_GOLDFISH_RTC
config GOLDFISH_RTC_MMIO
  hex "MMIO address of the goldfish RTC controller"
  default 0x10003000
endif # HAS_GOLDFISH_RTC

menuconfig HAS_SYSCON_RESET
  bool "Enable syscon reset/poweroff"
  default n
  help
    Provide a small MMIO syscon register used by standard
    syscon-poweroff/syscon-reboot device-tree nodes. This lets Linux or
    OpenSBI finish a real shutdown path instead of relying on host kill.

if HAS_SYSCON_RESET
config SYSCON_RESET_MMIO
  hex "MMIO address of the syscon reset register"
  default 0x100000

config SYSCON_POWEROFF_VALUE
  hex "Poweroff value"
  default 0x5555

config SYSCON_REBOOT_VALUE
  hex "Reboot value"
  default 0x7777
endif # HAS_SYSCON_RESET

menuconfig HAS_SDCARD
  bool "Enable sdcard"
  default n

if HAS_SDCARD
config SDCARD_CTL_MMIO
  hex "MMIO address of the sdcard controller"
  default 0xa3000000

config SDCARD_IMG_PATH
  string "The path of sdcard image"
  default ""
endif # HAS_SDCARD
endif

endif # DEVICE
```
